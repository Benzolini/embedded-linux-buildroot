## Config.in
```kconfig
menu "Raspberry Pi B+ external packages"

source "$BR2_EXTERNAL_RASPBERRYPI_BPLUS_PATH/package/gpio-test/Config.in"

endmenu
```

## package/gpio-test/Config.in
```kconfig
config BR2_PACKAGE_GPIO_TEST
    bool "gpio-test"
    help
      Simple GPIO17 LED blinking application for Raspberry Pi B+.
```
